## bgt-linux-pcie-drv/v4l/Kconfig
```kconfig
mainmenu "V4L/DVB menu"
source Kconfig.kern
config VIDEO_KERNEL_VERSION
	bool "Enable drivers not supported by this kernel"
	default n
	---help---
	  Normally drivers that require a kernel newer 3.10.17,
	  the kernel you are compiling for now, will be disabled.

	  Turning this switch on will let you enabled them, but be warned
	  they may not work properly or even compile.

	  They may also work fine, and the only reason they are listed as
	  requiring a newer kernel is that no one has tested them with an
	  older one yet.

	  If the driver works, please post a report to the V4L mailing list:
			 linux-media@vger.kernel.org.

	  Unless you know what you are doing, you should answer N.

#
# Multimedia device configuration
#

menuconfig MEDIA_SUPPORT
	tristate "Multimedia support"
	depends on HAS_IOMEM
	help
	  If you want to use Video for Linux, DVB for Linux, or DAB adapters,
	  enable this option and other options below.

if MEDIA_SUPPORT

comment "Multimedia core support"

#
# V4L core and enabled API's
#

config VIDEO_DEV
	tristate "Video For Linux"
	---help---
	  V4L core support for video capture and overlay devices, webcams and
	  AM/FM radio cards.

	  This kernel includes support for the new Video for Linux Two API,
	  (V4L2).

	  Additional info and docs are available on the web at
	  <http://linuxtv.org>

	  Documentation for V4L2 is also available on the web at
	  <http://bytesex.org/v4l/>.

	  To compile this driver as a module, choose M here: the
	  module will be called videodev.

config VIDEO_V4L2_COMMON
	tristate
	depends on (I2C || I2C=n) && VIDEO_DEV
	default (I2C || I2C=n) && VIDEO_DEV

config VIDEO_ALLOW_V4L1
	bool "Enable Video For Linux API 1 (DEPRECATED)"
	depends on VIDEO_DEV && VIDEO_V4L2_COMMON
	default VIDEO_DEV && VIDEO_V4L2_COMMON
	---help---
	  Enables drivers based on the legacy V4L1 API.

	  This api were developed to be used at Kernel 2.2 and 2.4, but
	  lacks support for several video standards. There are several
	  drivers at kernel that still depends on it.

	  If you are unsure as to whether this is required, answer Y.

config VIDEO_V4L1_COMPAT
	bool "Enable Video For Linux API 1 compatible Layer" if !VIDEO_ALLOW_V4L1
	depends on VIDEO_DEV
	default y
	---help---
	  Enables a compatibility API used by most V4L2 devices to allow
	  its usage with legacy applications that supports only V4L1 api.

	  Documentation for the original API is included in the file
	  <Documentation/video4linux/API.html>.

	  User tools for this are available from
	  <ftp://ftp.uk.linux.org/pub/linux/video4linux/>.

	  If you are unsure as to whether this is required, answer Y.

#
# DVB Core
#

config DVB_NET
	tristate "DVB for Linux NET"
	depends on NET && INET
	select CRC32

config DVB_CORE
	tristate "DVB for Linux"
	depends on NET && INET
	select CRC32
	help
	  DVB core utility functions for device handling, software fallbacks etc.

	  Enable this if you own a DVB/ATSC adapter and want to use it or if
	  you compile Linux for a digital SetTopBox.

	  Say Y when you have a DVB or an ATSC card and want to use it.

	  API specs and user tools are available from <http://www.linuxtv.org/>.

	  Please report problems regarding this support to the LinuxDVB
	  mailing list.

	  If unsure say N.

config VIDEO_MEDIA
	tristate
	default (DVB_CORE && (VIDEO_DEV = n)) || (VIDEO_DEV && (DVB_CORE = n)) || (DVB_CORE && VIDEO_DEV)

comment "Multimedia drivers"

#config VIDEO_SAA7146
#	tristate
#	depends on I2C && PCI
#
#config VIDEO_SAA7146_VV
#	tristate
#	depends on VIDEO_V4L2
#	select VIDEOBUF_DMA_SG
#	select VIDEO_SAA7146

#
# Tuner drivers for DVB and V4L
#

config MEDIA_ATTACH
	bool "Load and attach frontend and tuner driver modules as needed"
	depends on VIDEO_MEDIA
	depends on MODULES
	help
	  Remove the static dependency of DVB card drivers on all
	  frontend modules for all possible card variants. Instead,
	  allow the card drivers to only load the frontend modules
	  they require.

	  Also, tuner module will automatically load a tuner driver
	  when needed, for analog mode.

	  This saves several KBytes of memory.

	  Note: You will need module-init-tools v3.2 or later for this feature.

	  If unsure say Y.

config MEDIA_TUNER
	tristate
	default VIDEO_MEDIA && I2C
	depends on VIDEO_MEDIA && I2C
	select MEDIA_TUNER_XC2028 if !MEDIA_TUNER_CUSTOMISE
	select MEDIA_TUNER_XC5000 if !MEDIA_TUNER_CUSTOMISE
	select MEDIA_TUNER_MT20XX if !MEDIA_TUNER_CUSTOMISE
	select MEDIA_TUNER_TDA8290 if !MEDIA_TUNER_CUSTOMISE
	select MEDIA_TUNER_TEA5761 if !MEDIA_TUNER_CUSTOMISE
	select MEDIA_TUNER_TEA5767 if !MEDIA_TUNER_CUSTOMISE
	select MEDIA_TUNER_SIMPLE if !MEDIA_TUNER_CUSTOMISE
	select MEDIA_TUNER_TDA9887 if !MEDIA_TUNER_CUSTOMISE
	select MEDIA_TUNER_MC44S803 if !MEDIA_TUNER_CUSTOMISE

menuconfig MEDIA_TUNER_CUSTOMISE
	bool "Customize analog and hybrid tuner modules to build"
	depends on MEDIA_TUNER
	default n
	help
	  This allows the user to deselect tuner drivers unnecessary
	  for their hardware from the build. Use this option with care
	  as deselecting tuner drivers which are in fact necessary will
	  result in V4L/DVB devices which cannot be tuned due to lack of
	  driver support

	  If unsure say N.

if MEDIA_TUNER_CUSTOMISE

config MEDIA_TUNER_SIMPLE
	tristate "Simple tuner support"
	depends on VIDEO_MEDIA && I2C
	select MEDIA_TUNER_TDA9887
	default m if MEDIA_TUNER_CUSTOMISE
	help
	  Say Y here to include support for various simple tuners.

config MEDIA_TUNER_TDA18271
	tristate "NXP TDA18271 silicon tuner"
	depends on VIDEO_MEDIA && I2C
	default m if MEDIA_TUNER_CUSTOMISE
	help
	  A silicon tuner module. Say Y when you want to support this tuner.


endif # MEDIA_TUNER_CUSTOMISE

#
# Video/Radio/Hybrid adapters
#

#
# Generic video config states
#

# Enable the V4L2 core and API
config VIDEO_V4L2
	tristate
	depends on (I2C || I2C=n) && VIDEO_DEV
	default (I2C || I2C=n) && VIDEO_DEV

config VIDEO_ADV_DEBUG
	bool "Enable advanced debug functionality on V4L2 drivers"
	default n
	---help---
	  Say Y here to enable advanced debugging functionality on some
	  V4L devices.
	  In doubt, say N.

config VIDEO_FIXED_MINOR_RANGES
	bool "Enable old-style fixed minor ranges on drivers/video devices"
	default n
	---help---
	  Say Y here to enable the old-style fixed-range minor assignments.
	  Only useful if you rely on the old behavior and use mknod instead of udev.

	  When in doubt, say N.

config VIDEO_PCI_SKELETON
	tristate "Skeleton PCI V4L2 driver"
	depends on PCI && BUILD_DOCSRC
	depends on VIDEO_V4L2 && VIDEOBUF2_CORE
	depends on VIDEOBUF2_MEMOPS && VIDEOBUF2_DMA_CONTIG
	---help---
	  Enable build of the skeleton PCI driver, used as a reference
	  when developing new drivers.

# Used by drivers that need tuner.ko
config VIDEO_TUNER
	tristate
	depends on MEDIA_TUNER

# Used by drivers that need v4l2-mem2mem.ko
config V4L2_MEM2MEM_DEV
        tristate
        depends on VIDEOBUF2_CORE

# Used by drivers that need Videobuf modules
config VIDEOBUF_GEN
	tristate

config VIDEOBUF_DMA_SG
	tristate
	depends on HAS_DMA
	select VIDEOBUF_GEN

config VIDEOBUF_VMALLOC
	tristate
	select VIDEOBUF_GEN

config VIDEOBUF_DMA_CONTIG
	tristate
	depends on HAS_DMA
	select VIDEOBUF_GEN

config VIDEOBUF_DVB
	tristate
	select VIDEOBUF_GEN

# Used by drivers that need Videobuf2 modules
config VIDEOBUF2_CORE
	select DMA_SHARED_BUFFER
	tristate

config VIDEOBUF2_MEMOPS
	tristate

config VIDEOBUF2_DMA_CONTIG
	tristate
	depends on HAS_DMA
	select VIDEOBUF2_CORE
	select VIDEOBUF2_MEMOPS
	select DMA_SHARED_BUFFER

config VIDEOBUF2_VMALLOC
	tristate
	select VIDEOBUF2_CORE
	select VIDEOBUF2_MEMOPS
	select DMA_SHARED_BUFFER

config VIDEOBUF2_DMA_SG
	tristate
	#depends on HAS_DMA
	select VIDEOBUF2_CORE
	select VIDEOBUF2_MEMOPS

config VIDEOBUF2_DVB
	tristate
	select VIDEOBUF2_CORE

#source "drivers/media/radio/Kconfig"
#
#
# DVB adapters
#

#
# DVB device configuration
#

config DVB_DYNAMIC_MINORS
	bool "Dynamic DVB minor allocation"
	depends on DVB_CORE
	default n
	help
	  If you say Y here, the DVB subsystem will use dynamic minor
	  allocation for any device that uses the DVB major number.
	  This means that you can have more than 4 of a single type
	  of device (like demuxes and frontends) per adapter, but udev
	  will be required to manage the device nodes.

	  If you are unsure about this, say N here.

menuconfig DVB_CAPTURE_DRIVERS
	bool "DVB/ATSC adapters"
	depends on DVB_CORE
	default y
	---help---
	  Say Y to select Digital TV adapters

if DVB_CAPTURE_DRIVERS && DVB_CORE

comment "Supported DVB Frontends"
	depends on DVB_CORE
config DVB_FE_CUSTOMISE
	bool "Customise the frontend modules to build"
	depends on DVB_CORE
	default N
	help
	  This allows the user to select/deselect frontend drivers for their
	  hardware from the build.

	  Use this option with care as deselecting frontends which are in fact
	  necessary will result in DVB devices which cannot be tuned due to lack
	  of driver support.

	  If unsure say N.

if DVB_FE_CUSTOMISE

menu "Customise DVB Frontends"

comment "Multistandard (satellite) frontends"
	depends on DVB_CORE

config DVB_STV090x
	tristate "STV0900/STV0903(A/B) based"
	depends on DVB_CORE && I2C
	default m if DVB_FE_CUSTOMISE
	help
	  DVB-S/S2/DSS Multistandard Professional/Broadcast demodulators.
	  Say Y when you want to support these frontends.

config DVB_STV6110x
	tristate "STV6110/(A) based tuners"
	depends on DVB_CORE && I2C
	default m if DVB_FE_CUSTOMISE
	help
	  A Silicon tuner that supports DVB-S and DVB-S2 modes

config DVB_CXD2850
	tristate "Sony CXD2850"
	depends on DVB_CORE && I2C
	default m if DVB_FE_CUSTOMISE
	help
	  Say Y when you want to support this frontend.

comment "DVB-S (satellite) frontends"
	depends on DVB_CORE

comment "Multistandard frontends"
	depends on DVB_CORE

config DVB_TDA18272
	tristate "NXP TDA18272 based"
	depends on DVB_CORE && I2C
	default m if DVB_FE_CUSTOMISE
	help
	  A silicon tuner module. Say Y when you want to support this tuner.

config DVB_TDA10048
	tristate "Philips TDA10048HN based"
	depends on DVB_CORE && I2C
	default m if DVB_FE_CUSTOMISE
	help
	  A DVB-T tuner module. Say Y when you want to support this frontend.

config DVB_S5H1411
	tristate "Samsung S5H1411 based"
	depends on DVB_CORE && I2C
	default m if DVB_FE_CUSTOMISE
	help
	  An ATSC 8VSB and QAM64/256 tuner module. Say Y when you want
	  to support this frontend.

comment "SEC control devices for DVB-S"
	depends on DVB_CORE

config DVB_LNBP21
	tristate "LNBP21/LNBH24 SEC controllers"
	depends on DVB_CORE && I2C
	default m if DVB_FE_CUSTOMISE
	help
	  An SEC control chips.

config DVB_A8290
	tristate "Allegro A8290 SEC controller"
	depends on DVB_CORE && I2C
	default m if DVB_FE_CUSTOMISE
	help
	  A SEC controller.

comment "Tools to develop new frontends"

config DVB_DUMMY_FE
	tristate "Dummy frontend driver"
	default n

config DVB_CXD2820R
	tristate "Sony CXD2820R"
	depends on DVB_CORE && I2C
	default m if DVB_FE_CUSTOMISE
	help
	  Say Y when you want to support this frontend.

config DVB_CXD2834
	tristate "Sony CXD2834"
	depends on DVB_CORE && I2C
	default m if DVB_FE_CUSTOMISE
	help
	  Say Y when you want to support this frontend.

config DVB_CXD2817
	tristate "Sony CXD2817"
	depends on DVB_CORE && I2C
	default m if DVB_FE_CUSTOMISE
	help
	  Say Y when you want to support this frontend.

config DVB_CXD2861
	tristate "Sony CXD2861"
	depends on DVB_CORE && I2C
	default m if DVB_FE_CUSTOMISE
	help
	  Say Y when you want to support this tuner

config DVB_CXD2843
        tristate "Sony CXD2843"
        depends on DVB_CORE && I2C
        default m if DVB_FE_CUSTOMISE
        help
          Say Y when you want to support this tuner
endmenu

endif

endif # DVB_CAPTURE_DRIVERS

#config DAB
#	boolean "DAB adapters"
#	---help---
#	  Allow selecting support for Digital Audio Broadcasting (DAB)
#	  Receiver adapters.
#
#if DAB
#config USB_DABUSB
#	tristate "DABUSB driver"
#	depends on USB
#	---help---
#	  A Digital Audio Broadcasting (DAB) Receiver for USB and Linux
#	  brought to you by the DAB-Team
#	  <http://wwwbode.cs.tum.edu/Par/arch/dab/>.  This driver can be taken
#	  as an example for URB-based bulk, control, and isochronous
#	  transactions. URB's are explained in
#	  <Documentation/usb/URB.txt>.
#
#	  To compile this driver as a module, choose M here: the
#	  module will be called dabusb.
#endif # DAB

comment "Supported SAA7231 PCIe Bridges"
	depends on PCI && I2C
config SAA7231_CORE
	tristate "SAA7231 PCI Express bridge based devices"
	depends on PCI && I2C

	help
	  Support for PCI cards based on the SAA7231 PCI Express bridge.

	  Say Y if you own such a device and want to use it.

config SAA7231_DRV
	tristate "SAA7231 based PCIe cards"
	depends on SAA7231_CORE && PCI && I2C

	help
	  Support for the SAA7231 based Hybrid PCIe DVB cards
	  Currently supported devices are:

	  * NXP Reference (Purus)

	  Say Y if you own such a device and want to use it.

endif # MEDIA_SUPPORT
menu "Audio devices for multimedia"

# This is part of sound/pci/Kconfig
comment "ALSA sound"

config SND_BT87X
	tristate "Bt87x Audio Capture"
	depends on SND && PCI
	select SND_PCM
	help
	  If you want to record audio from TV cards based on
	  Brooktree Bt878/Bt879 chips, say Y here and read
	  <Documentation/sound/alsa/Bt87x.txt>.

	  To compile this driver as a module, choose M here: the module
	  will be called snd-bt87x.

config SND_BT87X_OVERCLOCK
	bool "Bt87x Audio overclocking"
	depends on SND_BT87X
	help
	  Say Y here if 448000 Hz isn't enough for you and you want to
	  record from the analog input with up to 1792000 Hz.

	  Higher sample rates won't hurt your hardware, but audio
	  quality may suffer.

config SND_FM801_TEA575X
	tristate "ForteMedia FM801 TEA5757 tuner"
	depends on VIDEO_V4L1 && SND_FM801

	help
	  Say Y here to include support for soundcards based on the ForteMedia
	  FM801 chip with a TEA5757 tuner connected to GPIO1-3 pins (Media
	  Forte SF256-PCS-02) into the snd-fm801 driver.

	  This will enable support for the old V4L1 API.

endmenu
```

## bgt-linux-pcie-drv/v4l/Kconfig.kern
```kconfig
# Needed by MEDIA_TUNER
config MEDIA_TUNER_MC44S803
	tristate
	default m

# Needed by MEDIA_TUNER
config MEDIA_TUNER_TEA5767
	tristate
	default m

# Needed by VIDEOBUF2_CORE, VIDEOBUF2_VMALLOC, VIDEOBUF2_DMA_CONTIG
config DMA_SHARED_BUFFER
	tristate
	default y

# Needed by MEDIA_TUNER
config MEDIA_TUNER_TEA5761
	tristate
	default m

# Needed by VIDEO_PCI_SKELETON
config BUILD_DOCSRC
	tristate
	default n

# Needed by DVB_CORE
config INET
	tristate
	default y

# Needed by SND_BT87X, SAA7231_DRV, SAA7231_CORE, VIDEO_PCI_SKELETON
config PCI
	tristate
	default y

# Needed by DVB_STV090x, DVB_CXD2834, DVB_CXD2850, DVB_CXD2820R, VIDEO_V4L2, VIDEO_V4L2_COMMON, SAA7231_DRV, DVB_A8290, DVB_S5H1411, MEDIA_TUNER, DVB_LNBP21, DVB_CXD2861, DVB_STV6110x, DVB_CXD2817, MEDIA_TUNER_SIMPLE, DVB_TDA10048, DVB_CXD2843, SAA7231_CORE, DVB_TDA18272, MEDIA_TUNER_TDA18271
config I2C
	tristate
	default m

# Needed by DVB_CORE
config NET
	tristate
	default y

# Needed by MEDIA_TUNER
config MEDIA_TUNER_XC2028
	tristate
	default m

# Needed by MEDIA_TUNER
config MEDIA_TUNER_TDA8290
	tristate
	default m

# Needed by SND_BT87X
config SND
	tristate
	default m

# Needed by DVB_CORE
config CRC32
	tristate
	default y

# Needed by SND_FM801_TEA575X
config VIDEO_V4L1
	tristate
	default n

# Needed by MEDIA_TUNER
config MEDIA_TUNER_MT20XX
	tristate
	default m

# Needed by SND_BT87X
config SND_PCM
	tristate
	default m

# Needed by SND_FM801_TEA575X
config SND_FM801
	tristate
	default m

# Needed by MEDIA_TUNER
config MEDIA_TUNER_XC5000
	tristate
	default m

# Needed by MEDIA_TUNER_SIMPLE, MEDIA_TUNER
config MEDIA_TUNER_TDA9887
	tristate
	default m

# Needed by MEDIA_SUPPORT
config HAS_IOMEM
	tristate
	default y

# Needed by VIDEOBUF_DMA_CONTIG, VIDEOBUF_DMA_SG, VIDEOBUF2_DMA_CONTIG
config HAS_DMA
	tristate
	default y

# Needed by MEDIA_ATTACH, always
config MODULES
	tristate
	default y
```
